## src/linux-4.14/drivers/gpu/drm/zx/Kconfig
```kconfig
config DRM_ZX
	tristate "Zhaoxin Graphics"
	depends on DRM
	depends on X86 && PCI
	select DRM_KMS_HELPER
	help
	  Choose this option to enable DRM on Zhaoxin Graphic functions.
```

## src/linux-4.14/drivers/gpu/drm_amd/hisilicon/Kconfig
```kconfig
#
# hisilicon drm device configuration.
# Please keep this list sorted alphabetically

source "drivers/gpu/drm_amd/hisilicon/hibmc/Kconfig"
source "drivers/gpu/drm_amd/hisilicon/kirin/Kconfig"
```

## src/linux-4.14/drivers/gpu/drm_amd/omapdrm/Kconfig
```kconfig
config DRM_OMAP
	tristate "OMAP DRM"
	depends on DRM_AMD
	depends on ARCH_OMAP2PLUS || ARCH_MULTIPLATFORM
	select OMAP2_DSS
	select DRM_KMS_HELPER
	default n
	help
	  DRM display driver for OMAP2/3/4 based boards.

if DRM_OMAP

source "drivers/gpu/drm_amd/omapdrm/dss/Kconfig"
source "drivers/gpu/drm_amd/omapdrm/displays/Kconfig"

endif
```

## src/linux-4.14/drivers/net/ethernet/al/Kconfig
```kconfig
#
# Annapurna Labs driver configuration
#

config NET_AL_ETH
	tristate "Annapurna Labs unified 1G/10G Ethernet driver"
	depends on PCI && INET
	depends on ARCH_ALPINE
	select PHYLIB
	help
	  This is the driver supports both standard and advanced Annapurna Labs
	  1G and 10G Ethernet controllers.

choice
	prompt "Receive buffers allocate mode"
        default AL_ETH_ALLOC_FRAG
        depends on NET_AL_ETH
	depends on ARCH_ALPINE

config AL_ETH_ALLOC_FRAG
         bool "Enabling frag allocation for rx buffers"
	depends on ARCH_ALPINE
        help
          Say Y here if you want to enabling frag allocations for rx buffers,
          in the Annapurna Labs eth driver.

config AL_ETH_ALLOC_PAGE
        bool "Enabling pages allocation for rx buffers"
	depends on ARCH_ALPINE
        help
          Say Y here if you want to enabling page allocations for rx buffers,
          in the Annapurna Labs eth driver.

config AL_ETH_ALLOC_SKB
        bool "Enabling skb allocation for rx buffers"
	depends on ARCH_ALPINE
        help
	  Say Y here if you want to enable skb allocations for rx buffers,
	  in the Annapurna Labs eth driver. This allocation mode is prefered for
	  data plane applications.

endchoice
```

## src/linux-4.14/drivers/nvme/target/Kconfig
```kconfig
config NVME_TARGET
	tristate "NVMe Target support"
	depends on BLOCK
	depends on CONFIGFS_FS
	help
	  This enabled target side support for the NVMe protocol, that is
	  it allows the Linux kernel to implement NVMe subsystems and
	  controllers and export Linux block devices as NVMe namespaces.
	  You need to select at least one of the transports below to make this
	  functionality useful.

	  To configure the NVMe target you probably want to use the nvmetcli
	  tool from http://git.infradead.org/users/hch/nvmetcli.git.

config NVME_TARGET_LOOP
	tristate "NVMe loopback device support"
	depends on NVME_TARGET
	select NVME_CORE
	select NVME_FABRICS
	select SG_POOL
	help
	  This enables the NVMe loopback device support, which can be useful
	  to test NVMe host and target side features.

	  If unsure, say N.

config NVME_TARGET_RDMA
	tristate "NVMe over Fabrics RDMA target support"
	depends on INFINIBAND
	depends on NVME_TARGET
	help
	  This enables the NVMe RDMA target support, which allows exporting NVMe
	  devices over RDMA.

	  If unsure, say N.

config NVME_TARGET_FC
	tristate "NVMe over Fabrics FC target driver"
	depends on NVME_TARGET
	depends on HAS_DMA
	help
	  This enables the NVMe FC target support, which allows exporting NVMe
	  devices over FC.

	  If unsure, say N.

config NVME_TARGET_FCLOOP
	tristate "NVMe over Fabrics FC Transport Loopback Test driver"
	depends on NVME_TARGET
	select NVME_CORE
	select NVME_FABRICS
	select SG_POOL
	depends on NVME_FC
	depends on NVME_TARGET_FC
	help
	  This enables the NVMe FC loopback test support, which can be useful
	  to test NVMe-FC transport interfaces.

config NVME_TARGET_QNAP_PCIE
	tristate "NVMe over Fabrics PCIe Transport driver"
	depends on ARCH_ALPINE
	depends on PCI_ENDPOINT
	depends on PCI_ALPINE_ENDPOINT
	depends on NVME_TARGET
	select NVME_CORE
	select NVME_FABRICS
	select SG_POOL
	help
	  This enables the NVMe QNAP PCIe test support.

	  If unsure, say N.

config NVME_TARGET_QNAP_PCIE_RWBUF
        bool "rw_buf scheme support"
	depends on NVME_TARGET_QNAP_PCIE
	help
	  This enables UDMA copy host data to/from rw_buf

config NVME_TARGET_QNAP_PCIE_RWBUF_RAM
        bool "rw_buf ram mode support"
	depends on NVME_TARGET_QNAP_PCIE_RWBUF
	help
	  This enables ram mode for rw_buf

config NVME_RAM_TEST
	tristate "NVMe read/write the I/O data from/to system RAM"
	depends on ARCH_ALPINE
	depends on PCI_ENDPOINT
	depends on PCI_ALPINE_ENDPOINT
	depends on NVME_TARGET
	depends on NVME_TARGET_QNAP_PCIE
	help
	  This enables the NVMe read/write the I/O data from/to system RAM
	  not the disk.

	  If unsure, say N.

config NVME_CMB_SUPPORT
	tristate "NVMe Controller Memory Buffer Feature"
	depends on ARCH_ALPINE
	depends on PCI_ENDPOINT
	depends on PCI_ALPINE_ENDPOINT
	depends on NVME_TARGET
	depends on NVME_TARGET_QNAP_PCIE
	help
	  The Controller Memory Buffer (CMB) is a region of general purpose
	  read/write memory on the controller that may be used for a variety
	  of purposes.

	  If unsure, say N.
```

## src/linux-4.14/drivers/pci/endpoint/alpine/Kconfig
```kconfig
menu "Annapurna Labs Alpine PCIe Endpoint drivers"
	depends on ARCH_ALPINE
	depends on PCI_ENDPOINT
	depends on OF

config PCI_ALPINE_ENDPOINT
	tristate "Annapurna Labs Alpine PCIe Endpoint Support"
	depends on ARCH_ALPINE
	depends on PCI_ENDPOINT
	depends on OF

config PCI_ALPINE_ENDPOINT_DISABLE_INTERRUPT_WITH_GPIO
	depends on PCI_ALPINE_ENDPOINT
	bool "Disable Interrupt function"

config PCI_ALPINE_ENDPOINT_CPLD
	depends on PCI_ALPINE_ENDPOINT_DISABLE_INTERRUPT_WITH_GPIO=n
	default y if PCI_ALPINE_ENDPOINT
	bool "support CPLD with SMbus in EP function"

config PCI_ALPINE_ENDPOINT_DEBUG
	tristate "Annapurna Labs Alpine PCIe Endpoint Debug Support"
	depends on ARCH_ALPINE
	depends on PCI_ENDPOINT
	depends on OF

config PCI_ALPINE_ENDPOINT_CABLE_DEBUG
	tristate "Annapurna Labs Alpine PCIe Endpoint Cable Debug Support"
	depends on ARCH_ALPINE
	depends on PCI_ENDPOINT
	depends on PCI_ALPINE_ENDPOINT_DEBUG
	depends on OF

config PCIE_KCONF_ENDPOINT_ID
	bool "Kernel Config EP Identity"
	depends on ARCH_ALPINE
	depends on PCI_ENDPOINT
	help
	  This is default using device tree, but you can KCONF setting EP0 ~ EP3 identity infomation

config PCIE_EP0_ENDPOINT_ID
	bool "Enable EP0 Identity Configure"
	depends on PCIE_KCONF_ENDPOINT_ID

config PCIE_EP0_VENDOR_ID_ADDR
	hex "Set EP0 Vendor ID address"
	depends on PCIE_EP0_ENDPOINT_ID
	default 0x1baa

config PCIE_EP0_DEVICE_ID_ADDR
	hex "Set EP0 Device ID address"
	depends on PCIE_EP0_ENDPOINT_ID
	default 0xffff

config PCIE_EP0_REVISION_ID_ADDR
	hex "Set EP0 Revision ID address"
	depends on PCIE_EP0_ENDPOINT_ID
	default 0x0000

config PCIE_EP0_SUBSYSTEM_VENDOR_ID_ADDR
	hex "Set EP0 Subsystem Vendor ID address"
	depends on PCIE_EP0_ENDPOINT_ID
	default 0x1baa

config PCIE_EP0_SUBSYSTEM_DEVICE_ID_ADDR
	hex "Set EP0 Subsystem Device ID address"
	depends on PCIE_EP0_ENDPOINT_ID
	default 0x0000

config PCIE_EP1_ENDPOINT_ID
	bool "Enable EP1 Identity Configure"
	depends on PCIE_KCONF_ENDPOINT_ID

config PCIE_EP1_VENDOR_ID_ADDR
	hex "Set EP1 Vendor ID address"
	depends on PCIE_EP1_ENDPOINT_ID
	default 0x1baa

config PCIE_EP1_DEVICE_ID_ADDR
	hex "Set EP1 Device ID address"
	depends on PCIE_EP1_ENDPOINT_ID
	default 0x0000

config PCIE_EP1_REVISION_ID_ADDR
	hex "Set EP1 Revision ID address"
	depends on PCIE_EP1_ENDPOINT_ID
	default 0x0000

config PCIE_EP1_SUBSYSTEM_VENDOR_ID_ADDR
	hex "Set EP1 Subsystem Vendor ID address"
	depends on PCIE_EP1_ENDPOINT_ID
	default 0x1baa

config PCIE_EP1_SUBSYSTEM_DEVICE_ID_ADDR
	hex "Set EP1 Subsystem Device ID address"
	depends on PCIE_EP1_ENDPOINT_ID
	default 0x0000

config PCIE_EP2_ENDPOINT_ID
	bool "Enable EP2 Identity Configure"
	depends on PCIE_KCONF_ENDPOINT_ID

config PCIE_EP2_VENDOR_ID_ADDR
	hex "Set EP2 Vendor ID address"
	depends on PCIE_EP2_ENDPOINT_ID
	default 0x1baa

config PCIE_EP2_DEVICE_ID_ADDR
	hex "Set EP2 Device ID address"
	depends on PCIE_EP2_ENDPOINT_ID
	default 0x0000

config PCIE_EP2_REVISION_ID_ADDR
	hex "Set EP2 Revision ID address"
	depends on PCIE_EP2_ENDPOINT_ID
	default 0x0000

config PCIE_EP2_SUBSYSTEM_VENDOR_ID_ADDR
	hex "Set EP2 Subsystem Vendor ID address"
	depends on PCIE_EP2_ENDPOINT_ID
	default 0x1baa

config PCIE_EP2_SUBSYSTEM_DEVICE_ID_ADDR
	hex "Set EP2 Subsystem Device ID address"
	depends on PCIE_EP2_ENDPOINT_ID
	default 0x0000

config PCIE_EP3_ENDPOINT_ID
	bool "Enable EP3 Identity Configure"
	depends on PCIE_KCONF_ENDPOINT_ID

config PCIE_EP3_VENDOR_ID_ADDR
	hex "Set EP3 Vendor ID address"
	depends on PCIE_EP3_ENDPOINT_ID
	default 0x1baa

config PCIE_EP3_DEVICE_ID_ADDR
	hex "Set EP3 Device ID address"
	depends on PCIE_EP3_ENDPOINT_ID
	default 0x0000

config PCIE_EP3_REVISION_ID_ADDR
	hex "Set EP3 Revision ID address"
	depends on PCIE_EP3_ENDPOINT_ID
	default 0x0000

config PCIE_EP3_SUBSYSTEM_VENDOR_ID_ADDR
	hex "Set EP3 Subsystem Vendor ID address"
	depends on PCIE_EP3_ENDPOINT_ID
	default 0x1baa

config PCIE_EP3_SUBSYSTEM_DEVICE_ID_ADDR
	hex "Set EP3 Subsystem Device ID address"
	depends on PCIE_EP3_ENDPOINT_ID
	default 0x0000

endmenu
```

## src/linux-5.10/drivers/scsi/qnap/Kconfig
```kconfig
#
# Kernel configuration file for the QNAP scsi feature
#
# Copyright (C) 2018 QNAP Inc.  All rights reserved.
#
# Authors:
#   QNAP iscsi team
#
# This program is free software; you can redistribute it and/or modify
# it under the terms of the GNU General Public version 2 License as
# published by the Free Software Foundation

menu "QNAP SCSI device support"

config VIRTUAL_DISK
	bool "Virtual DISK support"
	default n
	depends on MACH_QNAPTS
	help
	Provide VIRTUAL DISK Feature

config VIRTUAL_DISK_EX
	bool "Virtual DISK Extention"
	default n
	depends on VIRTUAL_DISK
	help
	Extention for VIRTUAL DISK Feature

config VIRTUAL_JBOD
	bool "Virtual JBOD support"
	default n
	depends on MACH_QNAPTS
	help
	Provide VIRTUAL_JBOD Feature

config VIRTUAL_JBOD_DEBUG
	bool "Virtual JBOD Debug support"
	default n
	depends on VIRTUAL_JBOD
	help
	Provide VIRTUAL_JBOD DEBUG Messages

endmenu
```
